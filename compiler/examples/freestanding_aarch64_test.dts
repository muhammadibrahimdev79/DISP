/dts-v1/;

/ {
    #address-cells = <2>;
    #size-cells = <2>;

    memory@40000000 {
        reg = <0x0 0x40000000 0x0 0x08000000>;
        device_type = "memory";
    };

    uart@9000000 {
        reg = <0x0 0x09000000 0x0 0x1000>;
        compatible = "arm,primecell", "arm,pl011";
    };
};
